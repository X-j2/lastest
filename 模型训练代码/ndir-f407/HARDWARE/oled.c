#include <string.h>
#include "stm32f4xx_gpio.h"
#include "stm32f4xx_rcc.h"
#include "delay.h"
#include "oled.h"

/* OLED 使用软件 I2C：PB6=SCL，PB7=SDA，均为开漏输出。 */
#define OLED_GPIO          GPIOB
#define OLED_GPIO_RCC      RCC_AHB1Periph_GPIOB
#define OLED_SCL_PIN       GPIO_Pin_6
#define OLED_SDA_PIN       GPIO_Pin_7

static uint8_t oled_buffer[OLED_WIDTH * OLED_HEIGHT / 8U];

/* 5x7 ASCII 字库，字符范围为 0x20 到 0x7F。 */
static const uint8_t oled_font_5x7[96][5] =
{
    {0x00,0x00,0x00,0x00,0x00}, {0x00,0x00,0x5F,0x00,0x00},
    {0x00,0x07,0x00,0x07,0x00}, {0x14,0x7F,0x14,0x7F,0x14},
    {0x24,0x2A,0x7F,0x2A,0x12}, {0x23,0x13,0x08,0x64,0x62},
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    {0x08,0x04,0x08,0x10,0x08}, {0x00,0x06,0x09,0x09,0x06}
};

static void OLED_I2C_Delay(void)
{
    volatile uint16_t index;
    for (index = 0U; index < 105U; index++)
    {
        __NOP();
    }
}

static void OLED_SCL(uint8_t level)
{
    if (level != 0U)
    {
        GPIO_SetBits(OLED_GPIO, OLED_SCL_PIN);
    }
    else
    {
        GPIO_ResetBits(OLED_GPIO, OLED_SCL_PIN);
    }
}

static void OLED_SDA(uint8_t level)
{
    if (level != 0U)
    {
        GPIO_SetBits(OLED_GPIO, OLED_SDA_PIN);
    }
    else
    {
        GPIO_ResetBits(OLED_GPIO, OLED_SDA_PIN);
    }
}

static void OLED_I2C_Start(void)
{
    OLED_SDA(1U);
    OLED_SCL(1U);
    OLED_I2C_Delay();
    OLED_SDA(0U);
    OLED_I2C_Delay();
    OLED_SCL(0U);
}

static void OLED_I2C_Stop(void)
{
    OLED_SDA(0U);
    OLED_SCL(1U);
    OLED_I2C_Delay();
    OLED_SDA(1U);
    OLED_I2C_Delay();
}

static void OLED_I2C_WriteByte(uint8_t data)
{
    uint8_t bit_index;

    for (bit_index = 0U; bit_index < 8U; bit_index++)
    {
        OLED_SDA((data & 0x80U) != 0U ? 1U : 0U);
        OLED_I2C_Delay();
        OLED_SCL(1U);
        OLED_I2C_Delay();
        OLED_SCL(0U);
        data <<= 1U;
    }

    /* 释放 SDA 并产生第九个时钟，OLED 在此时返回 ACK。 */
    OLED_SDA(1U);
    OLED_I2C_Delay();
    OLED_SCL(1U);
    OLED_I2C_Delay();
    OLED_SCL(0U);
}

static void OLED_WriteCommand(uint8_t command)
{
    OLED_I2C_Start();
    OLED_I2C_WriteByte((uint8_t)(OLED_I2C_ADDRESS << 1U));
    OLED_I2C_WriteByte(0x00U);
    OLED_I2C_WriteByte(command);
    OLED_I2C_Stop();
}

void OLED_Init(void)
{
    GPIO_InitTypeDef gpio_init;

    RCC_AHB1PeriphClockCmd(OLED_GPIO_RCC, ENABLE);
    gpio_init.GPIO_Pin = OLED_SCL_PIN | OLED_SDA_PIN;
    gpio_init.GPIO_Speed = GPIO_Speed_100MHz;
    gpio_init.GPIO_Mode = GPIO_Mode_OUT;
    gpio_init.GPIO_OType = GPIO_OType_OD;
    gpio_init.GPIO_PuPd = GPIO_PuPd_UP;
    GPIO_Init(OLED_GPIO, &gpio_init);
    GPIO_SetBits(OLED_GPIO, OLED_SCL_PIN | OLED_SDA_PIN);

    Delay_ms(100U);
    OLED_WriteCommand(0xAEU); /* 关闭显示。 */
    OLED_WriteCommand(0x20U); OLED_WriteCommand(0x02U); /* 页寻址模式。 */
    OLED_WriteCommand(0xB0U);
    OLED_WriteCommand(0xC8U); /* COM 扫描方向旋转 180 度。 */
    OLED_WriteCommand(0x00U);
    OLED_WriteCommand(0x10U);
    OLED_WriteCommand(0x40U);
    OLED_WriteCommand(0x81U); OLED_WriteCommand(0x7FU);
    OLED_WriteCommand(0xA1U); /* 段重映射，配合 C8 旋转显示。 */
    OLED_WriteCommand(0xA6U);
    OLED_WriteCommand(0xA8U); OLED_WriteCommand(0x3FU);
    OLED_WriteCommand(0xA4U);
    OLED_WriteCommand(0xD3U); OLED_WriteCommand(0x00U);
    OLED_WriteCommand(0xD5U); OLED_WriteCommand(0x80U);
    OLED_WriteCommand(0xD9U); OLED_WriteCommand(0xF1U);
    OLED_WriteCommand(0xDAU); OLED_WriteCommand(0x12U);
    OLED_WriteCommand(0xDBU); OLED_WriteCommand(0x40U);
    OLED_WriteCommand(0x8DU); OLED_WriteCommand(0x14U);
    OLED_WriteCommand(0xAFU); /* 开启显示。 */

    OLED_Clear();
    OLED_Refresh();
}

void OLED_Clear(void)
{
    memset(oled_buffer, 0, sizeof(oled_buffer));
}

void OLED_Refresh(void)
{
    uint8_t page;
    uint8_t column;

    for (page = 0U; page < 8U; page++)
    {
        OLED_WriteCommand((uint8_t)(0xB0U | page));
        OLED_WriteCommand(0x00U);
        OLED_WriteCommand(0x10U);

        OLED_I2C_Start();
        OLED_I2C_WriteByte((uint8_t)(OLED_I2C_ADDRESS << 1U));
        OLED_I2C_WriteByte(0x40U);
        for (column = 0U; column < OLED_WIDTH; column++)
        {
            OLED_I2C_WriteByte(oled_buffer[(uint16_t)page * OLED_WIDTH + column]);
        }
        OLED_I2C_Stop();
    }
}

void OLED_DrawPixel(uint8_t x, uint8_t y, uint8_t color)
{
    uint16_t index;
    uint8_t mask;

    if ((x >= OLED_WIDTH) || (y >= OLED_HEIGHT))
    {
        return;
    }

    index = (uint16_t)(y / 8U) * OLED_WIDTH + x;
    mask = (uint8_t)(1U << (y & 0x07U));
    if (color != 0U)
    {
        oled_buffer[index] |= mask;
    }
    else
    {
        oled_buffer[index] &= (uint8_t)(~mask);
    }
}

void OLED_DrawLine(int16_t x0, int16_t y0, int16_t x1, int16_t y1)
{
    int16_t dx = (x1 >= x0) ? (x1 - x0) : (x0 - x1);
    int16_t sx = (x0 < x1) ? 1 : -1;
    int16_t dy = (y1 >= y0) ? (y0 - y1) : (y1 - y0);
    int16_t sy = (y0 < y1) ? 1 : -1;
    int16_t error = dx + dy;
    int16_t error2;

    for (;;)
    {
        if ((x0 >= 0) && (x0 < (int16_t)OLED_WIDTH) &&
            (y0 >= 0) && (y0 < (int16_t)OLED_HEIGHT))
        {
            OLED_DrawPixel((uint8_t)x0, (uint8_t)y0, 1U);
        }

        if ((x0 == x1) && (y0 == y1))
        {
            break;
        }

        error2 = (int16_t)(2 * error);
        if (error2 >= dy)
        {
            error += dy;
            x0 += sx;
        }
        if (error2 <= dx)
        {
            error += dx;
            y0 += sy;
        }
    }
}

void OLED_DrawChar(uint8_t x, uint8_t y, char character)
{
    uint8_t column;
    uint8_t row;
    uint8_t data;
    uint8_t font_index;

    if ((character < 0x20) || (character > 0x7F))
    {
        character = '?';
    }
    font_index = (uint8_t)character - 0x20U;

    for (column = 0U; column < 5U; column++)
    {
        data = oled_font_5x7[font_index][column];
        for (row = 0U; row < 7U; row++)
        {
            if ((data & (1U << row)) != 0U)
            {
                OLED_DrawPixel((uint8_t)(x + column), (uint8_t)(y + row), 1U);
            }
        }
    }
}

void OLED_DrawString(uint8_t x, uint8_t y, const char *text)
{
    while ((*text != '\0') && (x <= (OLED_WIDTH - 6U)))
    {
        OLED_DrawChar(x, y, *text);
        x = (uint8_t)(x + 6U);
        text++;
    }
}

void OLED_DrawUInt(uint8_t x, uint8_t y, uint32_t value, uint8_t minimum_digits)
{
    char digits[11];
    uint8_t count = 0U;
    uint8_t index;

    do
    {
        digits[count++] = (char)('0' + (value % 10U));
        value /= 10U;
    }
    while ((value != 0U) && (count < sizeof(digits)));

    while ((count < minimum_digits) && (count < sizeof(digits)))
    {
        digits[count++] = '0';
    }

    for (index = 0U; index < count; index++)
    {
        OLED_DrawChar((uint8_t)(x + index * 6U),
                      y,
                      digits[count - index - 1U]);
    }
}
